## drivers/kscan/Kconfig
```kconfig
menuconfig KSCAN_M65LEGOREV9
  bool "M65 Lego Rev 9 Keyboard Matrix"
  default y
  depends on GPIO
  depends on KSCAN
  depends on ZMK_DEBOUNCE
  help
    Enable the driver for the M65 Lego Rev 9 keyboard matrix.

if KSCAN_M65LEGOREV9

config KSCAN_M65LEGOREV9_INIT_PRIORITY
    int "M65 Lego Rev 9 initialization priority"
    default KSCAN_INIT_PRIORITY
    help
      The initialization priority for the M65 Lego Rev 9 kscan driver.

endif
```

## dts/bindings/kscan/m65legorev9,kscan.yaml
```yaml
description: M65 Lego Rev 9 matrix controller

compatible: "m65legorev9,kscan"

properties:
  latch-gpio:
    description: "Latch pin GPIO"
    type: phandle-array
    required: true
  clock-gpio:
    description: "Clock pin GPIO"
    type: phandle-array
    required: true
  data-out-gpio:
    description: "GPIO for shifting data out to the 74HC595"
    type: phandle-array
    required: true
  data-in-gpio:
    description: "GPIO for reading data in from 74HC165"
    type: phandle-array
    required: true
  debounce-period:
    type: int
    required: false
    deprecated: true
    description: Deprecated. Use debounce-press-ms and debounce-release-ms instead.
  debounce-press-ms:
    type: int
    default: 5
    description: Debounce time for key press in milliseconds. Use 0 for eager debouncing.
  debounce-release-ms:
    type: int
    default: 5
    description: Debounce time for key release in milliseconds.
  debounce-scan-period-ms:
    type: int
    default: 1
    description: Time between reads in milliseconds when any key is pressed.
  poll-period-ms:
    type: int
    default: 10
    description: Time between reads in milliseconds when no key is pressed and ZMK_KSCAN_MATRIX_POLLING is enabled.
```
